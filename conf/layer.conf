## conf/layer.conf
```bitbake
#
BBPATH .= ":${LAYERDIR}"
BBFILES += "\
            ${LAYERDIR}/packagegroups/*.bb \
            ${LAYERDIR}/packagegroups/*.bbappend \
            ${LAYERDIR}/recipes-*/*/*.bb \
            ${LAYERDIR}/recipes-*/*/*.bbappend \
           "

BBFILE_COLLECTIONS += "cisco-oss"
BBFILE_PATTERN_cisco-oss:= "^${LAYERDIR}/"
BBFILE_PRIORITY_cisco-oss= "5"
LAYERVERSION_cisco-oss= "1"
```
